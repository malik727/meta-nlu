## conf/layer.conf
```bitbake
# We have a conf and classes directory, add to BBPATH
BBPATH .= ":${LAYERDIR}"

# We have recipes-* directories, add to BBFILES
BBFILES += "${LAYERDIR}/recipes-*/*/*.bb \
            ${LAYERDIR}/recipes-*/*/*.bbappend"

BBFILE_COLLECTIONS += "meta-nlu"
BBFILE_PATTERN_meta-nlu = "^${LAYERDIR}/"
BBFILE_PRIORITY_meta-nlu = "65"

LAYERVERSION_meta-nlu = "4"
LAYERDEPENDS_meta-nlu = "core"
LAYERSERIES_COMPAT_meta-nlu = "kirkstone mickledore"
```
